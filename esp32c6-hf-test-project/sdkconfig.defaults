## esp32c6-hf-test-project/sdkconfig.defaults
```kconfig
# ESP32-C6 HardFOC Test Project Configuration

#
# Component config
#

# Bootloader config
CONFIG_BOOTLOADER_LOG_LEVEL_INFO=y

# Serial flasher config  
CONFIG_ESPTOOLPY_FLASHSIZE_4MB=y
CONFIG_ESPTOOLPY_FLASHMODE_QIO=y
CONFIG_ESPTOOLPY_FLASHFREQ_80M=y

# Partition Table
CONFIG_PARTITION_TABLE_CUSTOM=y
CONFIG_PARTITION_TABLE_CUSTOM_FILENAME="partitions.csv"

# Compiler options
CONFIG_COMPILER_OPTIMIZATION_SIZE=y
CONFIG_COMPILER_CXX_EXCEPTIONS=n
CONFIG_COMPILER_CXX_RTTI=n

# ESP32C6-Specific
CONFIG_IDF_TARGET_ESP32C6=y
CONFIG_ESP32C6_DEFAULT_CPU_FREQ_MHZ_160=y

# FreeRTOS
CONFIG_FREERTOS_HZ=1000
CONFIG_FREERTOS_TIMER_TASK_STACK_DEPTH=3072
CONFIG_FREERTOS_IDLE_TASK_STACKSIZE=1536

# ESP System Settings
CONFIG_ESP_TASK_WDT_EN=y
CONFIG_ESP_TASK_WDT_TIMEOUT_S=10
CONFIG_ESP_TASK_WDT_CHECK_IDLE_TASK_CPU0=y
CONFIG_ESP_MAIN_TASK_STACK_SIZE=8192

# Log output
CONFIG_LOG_DEFAULT_LEVEL_INFO=y
CONFIG_LOG_DEFAULT_LEVEL=3
CONFIG_LOG_MAXIMUM_LEVEL=5

# NVS
CONFIG_NVS_ENCRYPTION=n

# WiFi
CONFIG_ESP32C6_WIFI_ENABLE_WPA3_SAE=y
CONFIG_ESP_WIFI_STA_DISCONNECTED_PM_ENABLE=y

# GPIO
CONFIG_GPIO_ESP32C6_SUPPORT_SWITCH_SLP_PULL=y

# ADC
CONFIG_ADC_CONTINUOUS_ISR_IRAM_SAFE=y
CONFIG_ADC_ONESHOT_CTRL_FUNC_IN_IRAM=y

# SPI
CONFIG_SPI_MASTER_ISR_IN_IRAM=y

# I2C  
CONFIG_I2C_ISR_IRAM_SAFE=y

# UART
CONFIG_UART_ISR_IN_IRAM=y

# Timer
CONFIG_GPTIMER_ISR_IRAM_SAFE=y
CONFIG_GPTIMER_CTRL_FUNC_IN_IRAM=y

# Temperature Sensor
CONFIG_TEMP_SENSOR_ISR_IRAM_SAFE=y

# LEDC (PWM)
CONFIG_LEDC_CTRL_FUNC_IN_IRAM=y

# Memory
CONFIG_ESP_DEFAULT_CPU_FREQ_MHZ_160=y
CONFIG_SPIRAM=n

# Debug/Monitor
CONFIG_ESP_CONSOLE_UART_DEFAULT=y
CONFIG_ESP_CONSOLE_UART_BAUDRATE_115200=y

# Power Management
CONFIG_PM_ENABLE=y
CONFIG_PM_DFS_INIT_AUTO=y

# Security
CONFIG_SECURE_BOOT=n
CONFIG_SECURE_FLASH_ENC_ENABLED=n

# Application Manager
CONFIG_APP_RETRIEVE_LEN_ELF_SHA=16
CONFIG_APP_EXCLUDE_PROJECT_VER_VAR=n

# Heap memory debugging (disable for production)
CONFIG_HEAP_POISONING_DISABLED=y
CONFIG_HEAP_TRACING_OFF=y
```
